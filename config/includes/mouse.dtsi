#define ZMK_POINTING_DEFAULT_MOVE_VAL 600
#define ZMK_POINTING_DEFAULT_SCRL_VAL 20

#define U_MOUSE_MOVE_EXPONENT 1
#define U_MOUSE_MOVE_TIME 600
#define U_MOUSE_MOVE_DELAY 0
#define U_MOUSE_SCROLL_EXPONENT 0
#define U_MOUSE_SCROLL_TIME 500
#define U_MOUSE_SCROLL_DELAY 0

&mmv {
    acceleration-exponent = <U_MOUSE_MOVE_EXPONENT>;
    time-to-max-speed-ms = <U_MOUSE_MOVE_TIME>;
    delay-ms = <U_MOUSE_MOVE_DELAY>;
};

&msc {
    acceleration-exponent = <U_MOUSE_SCROLL_EXPONENT>;
    time-to-max-speed-ms = <U_MOUSE_SCROLL_TIME>;
    delay-ms = <U_MOUSE_SCROLL_DELAY>;
};
